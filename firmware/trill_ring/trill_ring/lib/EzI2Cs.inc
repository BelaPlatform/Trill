;;*****************************************************************************
;;*****************************************************************************
;;  FILENAME: EzI2Cs.inc
;;   Version: 1.40, Updated on 2012/9/21 at 11:56:12
;;  Generated by PSoC Designer 5.4.3191
;;
;;  DESCRIPTION: Assembler declarations for the EzI2Cs user module
;;-----------------------------------------------------------------------------
;;  Copyright (c) Cypress Semiconductor 2012. All Rights Reserved.
;;*****************************************************************************
;;*****************************************************************************


;--------------------------------------------------
; Constants for EzI2Cs_bBusy_Flag
;--------------------------------------------------
EzI2Cs_I2C_FREE :                      equ  0x00      ; No transaction at the current moment
EzI2Cs_I2C_BUSY_RAM_READ :             equ  0x01      ; RAM read transaction in progress
EzI2Cs_I2C_BUSY_RAM_WRITE:             equ  0x02      ; RAM write transaction in progress
EzI2Cs_I2C_BUSY_ROM_READ :             equ  0x04      ; ROM read transaction in progress
EzI2Cs_I2C_BUSY_ROM_WRITE:             equ  0x08      ; ROM write transaction in progress

;--------------------------------------------------
; Constants for EzI2Cs API's.
;--------------------------------------------------
EzI2Cs_DYNAMIC_ADDR:                   equ   1
EzI2Cs_ROM_ENABLE:                     equ   0
EzI2Cs_HW_ADDR_REC:                    equ   0
EzI2Cs_CY8C20xx7:                      equ   0

IF (EzI2Cs_ROM_ENABLE) 
   EzI2Cs_ADDR_MASK:                        equ  0x7E    ; Mask off ROM Addr and R/W bit
ELSE
   EzI2Cs_ADDR_MASK:                        equ  0xFE    ; Mask off  R/W bit
ENDIF

I2C_XCFG:      equ C8h          ; I2C Extended Configuration Register                (#)


;; I2C_CFG Register definitions
EzI2Cs_CFG_PSelect:                         equ  0x40   ; Pin Select, 0 = P1,7/5, 1 = P1,1,0
EzI2Cs_CFG_BUS_ERROR_IE:                    equ  0x20   ; Enable Interrupt on bus error
EzI2Cs_CFG_STOP_IE:                         equ  0x10   ; Enable Interrupt on Stop condition
EzI2Cs_CFG_CLOCK_100K:                      equ  0x00   ; 100kHz Standard clock rate
EzI2Cs_CFG_CLOCK_400K:                      equ  0x04   ; 400kHz Fast Mode
EzI2Cs_CFG_CLOCK_50K:                       equ  0x08   ; 50kHz  Standard Mode
EzI2Cs_CFG_Master_EN:                       equ  0x02   ; Enable Master Mode.               
EzI2Cs_CFG_Slave_EN:                        equ  0x01   ; Enable Slave Mode.               

;; I2C_SCR Register definitions
EzI2Cs_SCR_BUS_ERROR:                       equ  0x80  ; Bus Error                    
EzI2Cs_SCR_LOST_ARB:                        equ  0x40  ; Lost Arbitration  (Master Only)
EzI2Cs_SCR_STOP_STATUS:                     equ  0x20  ; Stop Status                  
EzI2Cs_SCR_ACK:                             equ  0x10  ; ACK Status                   
EzI2Cs_SCR_NAK:                             equ  0x00  ; NAK Status                   
EzI2Cs_SCR_ADDRESS:                         equ  0x08  ; Data is address.
EzI2Cs_SCR_TRANSMIT:                        equ  0x04  ; Sets direction of data flow                
EzI2Cs_SCR_LRB:                             equ  0x02  ; Last Received Bit                
EzI2Cs_SCR_BYTE_COM:                        equ  0x01  ; Byte Complete   

IF (EzI2Cs_CY8C20xx7) 
;; I2C_XCFG Register definitions
EzI2Cs_CSR_CLK_EN:                          equ  0x80  ; CSR_CLK_EN bitfied
EzI2Cs_FORCE_NACK:                          equ  0x10  ; FORCE_NACK bitfied

;; I2C_XSTAT Register definitions
EzI2Cs_BUS_BUSY:                             equ  0x80  ; This bit will be SET only if there is an ongoing I2C traffic on bus 
EzI2Cs_AUTO_NACK_ON:                         equ  0x04  ; This bit will be SET only if auto NACK feature is activated by I2C block
EzI2Cs_LAST_TX_RD:                           equ  0x20  ; This bit will be SET if last I2C transaction by host is a read operation
EzI2Cs_LAST_TX_WR:                           equ  0x40  ; This bit will be SET if last I2C transaction by host is a write operation
ENDIF

;; I2C_DR  Register definitions (Data Register)

;; I2C_MSCR Register definitions  (Master Mode Only)
EzI2Cs_MSCR_BUS_BUSY:                       equ  0x08  ; Bus is Busy with other trafic        
EzI2Cs_MSCR_MASTER_MODE:                    equ  0x04  ; ?????
EzI2Cs_MSCR_RESTART_REN:                    equ  0x02  ; Generate a Restart
EzI2Cs_MSCR_START_REN:                      equ  0x01  ; Generate a Start


;; Valid address
EzI2Cs_SLAVE_ADDR:                          equ  (0x0<<1)        ; Permanent Slave Address
EzI2Cs_ALT_SLAVE_ADDR:                      equ  ((0x0<<1)&0x80) ; Permanent Slave Address
EzI2Cs_HW_SLAVE_ADDR:                       equ  0x0             ; HW Slave Address

EzI2Cs_ALT_ADDR_BIT:                        equ  0x80 ; Alternate Address bit
EzI2Cs_RW_FLAG:                             equ  0x01 ; Read/Write flag      
EzI2Cs_RD_FLAG:                             equ  0x01 ; Read/Write flag      
EzI2Cs_WR_FLAG:                             equ  0x00 ; Read/Write flag      

EzI2Cs_CFG_REG: equ d6h                 ; I2C Configuration Register
EzI2Cs_SCR_REG: equ d7h                 ; I2C Enable Master/Slave Block Operation
EzI2Cs_DR_REG:  equ d8h                 ; I2C Status and Control Register
EzI2Cs_XCFG_REG:    equ c8h            ; I2C HW Extended Configuration Register (I2C_XCFG)
EzI2Cs_ADDR_REG:    equ cah              ; I2C HW Addres Register (I2C_ADDR)
IF (EzI2Cs_CY8C20xx7)
EzI2Cs_XSTAT_REG:   equ c9h            ; I2C HW Extended Status Register (I2C_XSTAT)
ENDIF

;; Bit definitions for EzI2Cs_bState
EzI2Cs_ACTIVITY_MASK:      equ  0xB0      ; Activity Mask
EzI2Cs_ANY_ACTIVITY:       equ  0x80      ; Any I2C bus activity.
EzI2Cs_READ_ACTIVITY:      equ  0x20      ; I2C read activity at primary address.
EzI2Cs_WRITE_ACTIVITY:     equ  0x10      ; I2C write activity at primary address.

;--------------------------------------------------
;   EzI2Cs API Constants
;--------------------------------------------------

EzI2Cs_INT_REG:                            equ 0x0e0
EzI2Cs_INT_MASK:                           equ 0x80


;I2C_(status and control) reg write macro
;----------------------------------------------------
;  I2C_SCR and I2C_MSCR reg write macro
;
;  Use the following macros to write to the I2C_SCR register
;  Usage:    SetI2C_SCR  WRITE_VALUE
;
;  where WRITE_VALUE is the data to be writen
;
;----------------------------------------------------


; Write to the  EzI2Cs_SCR register
    macro SetEzI2Cs_SCR
        mov   reg[EzI2Cs_SCR_REG], @0 ; write data to reg[I2C_SCR]
    endm

; end of file EzI2Cs.inc


