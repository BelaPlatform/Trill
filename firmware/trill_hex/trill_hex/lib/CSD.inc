;;*****************************************************************************
;;*****************************************************************************
;;  FILENAME:   CSD.inc
;;   Version: 2.10, Updated on 2012/9/21 at 11:56:9
;;  Generated by PSoC Designer 5.4.3191
;;
;;  DESCRIPTION:
;;    Assembler declarations for the CSD user module interface.
;;-----------------------------------------------------------------------------
;;  Copyright (c) Cypress Semiconductor 2012. All Rights Reserved.
;;*****************************************************************************
;;*****************************************************************************

CSD_CAPACITOR_PIN:                     equ 1h
CSD_CAPACITOR_NONE:                    equ 0h
CSD_CAPACITOR_P0_1:                    equ 1h
CSD_CAPACITOR_P0_3:                    equ 2h

CSD_AUTORESET:                         equ 0
CSD_DiplexUsed:                        equ 0
;--------------------------------------------------
; Constants for AutoCalibration 
;--------------------------------------------------
CSD_AUTOCAL_ENABLE:                    equ 1
CSD_IDAC_CALIBRATION_MSB:              equ 0dh
CSD_IDAC_CALIBRATION_LSB:              equ 99h
CSD_CALIBRATION_RESOLUTION:            equ 12

;--------------------------------------------------
; Constants for Scan Speed values
;--------------------------------------------------
CSD_SCANNING_SPEED:                    equ 0x0
CSD_ULTRA_FAST_SPEED:                  equ 0x00
CSD_FAST_SPEED:                        equ 0x01
CSD_NORMAL_SPEED:                      equ 0x02
CSD_SLOW_SPEED:                        equ 0x03

;--------------------------------------------------
; Constants for Prescaler values
;--------------------------------------------------
CSD_PRESCALER:                         equ 0x1
CSD_PRESCALER_1:                       equ 0x00
CSD_PRESCALER_2:                       equ 0x01
CSD_PRESCALER_4:                       equ 0x02
CSD_PRESCALER_8:                       equ 0x03
CSD_PRESCALER_16:                      equ 0x04
CSD_PRESCALER_32:                      equ 0x05
CSD_PRESCALER_64:                      equ 0x06
CSD_PRESCALER_128:                     equ 0x07
CSD_PRESCALER_256:                     equ 0x08

;--------------------------------------------------
; Constants for Resolution values
;--------------------------------------------------
CSD_MIN_RESOLUTION:                    equ 9
CSD_9_BIT_RESOLUTION:                  equ 9
CSD_10_BIT_RESOLUTION:                 equ 10
CSD_11_BIT_RESOLUTION:                 equ 11
CSD_12_BIT_RESOLUTION:                 equ 12
CSD_13_BIT_RESOLUTION:                 equ 13
CSD_14_BIT_RESOLUTION:                 equ 14
CSD_15_BIT_RESOLUTION:                 equ 15
CSD_16_BIT_RESOLUTION:                 equ 16
CSD_MAX_RESOLUTION:                    equ 16
CSD_RESOLUTION:                        equ ch

;--------------------------------------------------
; Constants for Shield out values
;--------------------------------------------------
CSD_SHIELD:                            equ 0h
CSD_SHIELD_NONE:                       equ 0h
CSD_SHIELD_P0_7:                       equ 1h
CSD_SHIELD_P1_2:                       equ 2h

;--------------------------------------------------
; Constants for Precharge clock source values
;--------------------------------------------------
CSD_PRCH_SRC:                          equ 0h
CSD_PRCH_IMO_P:                        equ 0h
CSD_PRCH_PRS:                          equ 20h

;--------------------------------------------------
; Constants for PRS values
;--------------------------------------------------
CSD_PRS_RES:                           equ 0h
CSD_PRCH_PRS8:                         equ 0h
CSD_PRCH_PRS12:                        equ 20h

;--------------------------------------------------
; Constants for CSD API's
;--------------------------------------------------

CSD_ButtonCount:                       equ 0h
CSD_SliderCount:                       equ 1h  + 0h
CSD_TotalSensorCount:                  equ 1eh

CSD_BUTTONS_EXIST:                     equ 0h
CSD_SLIDERS_EXIST:                     equ 1h | 0h

CSD_HYSTERESIS:                        equ ah
CSD_Debounce:                          equ 3h
CSD_LowBaselineReset:                  equ 32h

CSD_FINGER_THRESHOLD:                  equ 3ch
CSD_NOISE_THRESHOLD:                   equ 28h
CSD_NEGATIVE_NOISE_THRESHOLD:          equ ah
CSD_BASELINE_UPDATE_THRESHOLD:         equ 64h

CSD_IDAC:                              equ 14h
CSD_PRESCALER:                         equ 1h

CSD_INT_REG:                           equ 0x0df
CSD_INT_MASK:                          equ 0x01

;--------------------------------------------------
; Registers Address Constants for CSD
;--------------------------------------------------

CSD_CapSense_CR0_REG:                            equ a0h              ; CS_CR0 Reg
CSD_CapSense_CR1_REG:                            equ a1h              ; CS_CR1 Reg
CSD_CapSense_CR2_REG:                            equ a2h              ; CS_CR2 Reg
CSD_CapSense_CR3_REG:                            equ a3h              ; CS_CR3 Reg
CSD_CapSense_CNTH_REG:                           equ a5h              ; CS_Counter Reg
CSD_CapSense_CNTL_REG:                           equ a4h              ; CS_Countert Reg
CSD_CapSense_STAT_REG:                           equ a6h              ; CS_Stat Reg
CSD_CONFIG_REG:                                  equ b3h              ; Timer Control register
CSD_DATA1_REG:                                   equ b4h              ; Timer Data Hi Reg
CSD_DATA0_REG:                                   equ b5h              ; Timer Data Lo Reg
CSD_CMP_CR0_REG:                                 equ 7ah              ; CMP_CR0 Reg
CSD_CMP_CR1_REG:                                 equ 7bh              ; CMP_CR1 Reg
CSD_CMP_MUX_REG:                                 equ 79h              ; CMP_MUX Reg
CSD_PRS_CR_REG:                                  equ A9h                           ; PRS_CR Reg
DR_OFFSET:                                       equ 00h
DM0_OFFSET:                                      equ 00h              ; Bank 1
DM1_OFFSET:                                      equ 01h              ; Bank 1


; end of file CSD.inc
