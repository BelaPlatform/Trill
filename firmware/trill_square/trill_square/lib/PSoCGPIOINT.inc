;  Generated by PSoC Designer 5.4.3191
;
; CSDSW18 address and mask equates
CSDSW18_Data_ADDR:	equ	0h
CSDSW18_DriveMode_0_ADDR:	equ	100h
CSDSW18_DriveMode_1_ADDR:	equ	101h
CSDSW18_IntEn_ADDR:	equ	1h
CSDSW18_MASK:	equ	1h
CSDSW18_MUXBusCtrl_ADDR:	equ	1d8h
; CSDSW18_Data access macros
;   GetCSDSW18_Data macro, return in a
macro GetCSDSW18_Data
	mov		a,[Port_0_Data_SHADE]
	and		a, 1h
endm
;   SetCSDSW18_Data macro
macro SetCSDSW18_Data
	or		[Port_0_Data_SHADE], 1h
	mov		a, [Port_0_Data_SHADE]
	mov		reg[CSDSW18_Data_ADDR], a
endm
;   ClearCSDSW18_Data macro
macro ClearCSDSW18_Data
	and		[Port_0_Data_SHADE], ~1h
	mov		a, [Port_0_Data_SHADE]
	mov		reg[CSDSW18_Data_ADDR], a
endm

; CSDCapacitor address and mask equates
CSDCapacitor_Data_ADDR:	equ	0h
CSDCapacitor_DriveMode_0_ADDR:	equ	100h
CSDCapacitor_DriveMode_1_ADDR:	equ	101h
CSDCapacitor_IntEn_ADDR:	equ	1h
CSDCapacitor_MASK:	equ	2h
CSDCapacitor_MUXBusCtrl_ADDR:	equ	1d8h
; CSDCapacitor_Data access macros
;   GetCSDCapacitor_Data macro, return in a
macro GetCSDCapacitor_Data
	mov		a,[Port_0_Data_SHADE]
	and		a, 2h
endm
;   SetCSDCapacitor_Data macro
macro SetCSDCapacitor_Data
	or		[Port_0_Data_SHADE], 2h
	mov		a, [Port_0_Data_SHADE]
	mov		reg[CSDCapacitor_Data_ADDR], a
endm
;   ClearCSDCapacitor_Data macro
macro ClearCSDCapacitor_Data
	and		[Port_0_Data_SHADE], ~2h
	mov		a, [Port_0_Data_SHADE]
	mov		reg[CSDCapacitor_Data_ADDR], a
endm

; CSDSW17 address and mask equates
CSDSW17_Data_ADDR:	equ	0h
CSDSW17_DriveMode_0_ADDR:	equ	100h
CSDSW17_DriveMode_1_ADDR:	equ	101h
CSDSW17_IntEn_ADDR:	equ	1h
CSDSW17_MASK:	equ	4h
CSDSW17_MUXBusCtrl_ADDR:	equ	1d8h
; CSDSW17_Data access macros
;   GetCSDSW17_Data macro, return in a
macro GetCSDSW17_Data
	mov		a,[Port_0_Data_SHADE]
	and		a, 4h
endm
;   SetCSDSW17_Data macro
macro SetCSDSW17_Data
	or		[Port_0_Data_SHADE], 4h
	mov		a, [Port_0_Data_SHADE]
	mov		reg[CSDSW17_Data_ADDR], a
endm
;   ClearCSDSW17_Data macro
macro ClearCSDSW17_Data
	and		[Port_0_Data_SHADE], ~4h
	mov		a, [Port_0_Data_SHADE]
	mov		reg[CSDSW17_Data_ADDR], a
endm

; CSDSW4 address and mask equates
CSDSW4_Data_ADDR:	equ	0h
CSDSW4_DriveMode_0_ADDR:	equ	100h
CSDSW4_DriveMode_1_ADDR:	equ	101h
CSDSW4_IntEn_ADDR:	equ	1h
CSDSW4_MASK:	equ	8h
CSDSW4_MUXBusCtrl_ADDR:	equ	1d8h
; CSDSW4_Data access macros
;   GetCSDSW4_Data macro, return in a
macro GetCSDSW4_Data
	mov		a,[Port_0_Data_SHADE]
	and		a, 8h
endm
;   SetCSDSW4_Data macro
macro SetCSDSW4_Data
	or		[Port_0_Data_SHADE], 8h
	mov		a, [Port_0_Data_SHADE]
	mov		reg[CSDSW4_Data_ADDR], a
endm
;   ClearCSDSW4_Data macro
macro ClearCSDSW4_Data
	and		[Port_0_Data_SHADE], ~8h
	mov		a, [Port_0_Data_SHADE]
	mov		reg[CSDSW4_Data_ADDR], a
endm

; CSDSW16 address and mask equates
CSDSW16_Data_ADDR:	equ	0h
CSDSW16_DriveMode_0_ADDR:	equ	100h
CSDSW16_DriveMode_1_ADDR:	equ	101h
CSDSW16_IntEn_ADDR:	equ	1h
CSDSW16_MASK:	equ	10h
CSDSW16_MUXBusCtrl_ADDR:	equ	1d8h
; CSDSW16_Data access macros
;   GetCSDSW16_Data macro, return in a
macro GetCSDSW16_Data
	mov		a,[Port_0_Data_SHADE]
	and		a, 10h
endm
;   SetCSDSW16_Data macro
macro SetCSDSW16_Data
	or		[Port_0_Data_SHADE], 10h
	mov		a, [Port_0_Data_SHADE]
	mov		reg[CSDSW16_Data_ADDR], a
endm
;   ClearCSDSW16_Data macro
macro ClearCSDSW16_Data
	and		[Port_0_Data_SHADE], ~10h
	mov		a, [Port_0_Data_SHADE]
	mov		reg[CSDSW16_Data_ADDR], a
endm

; CSDSW5 address and mask equates
CSDSW5_Data_ADDR:	equ	0h
CSDSW5_DriveMode_0_ADDR:	equ	100h
CSDSW5_DriveMode_1_ADDR:	equ	101h
CSDSW5_IntEn_ADDR:	equ	1h
CSDSW5_MASK:	equ	20h
CSDSW5_MUXBusCtrl_ADDR:	equ	1d8h
; CSDSW5_Data access macros
;   GetCSDSW5_Data macro, return in a
macro GetCSDSW5_Data
	mov		a,[Port_0_Data_SHADE]
	and		a, 20h
endm
;   SetCSDSW5_Data macro
macro SetCSDSW5_Data
	or		[Port_0_Data_SHADE], 20h
	mov		a, [Port_0_Data_SHADE]
	mov		reg[CSDSW5_Data_ADDR], a
endm
;   ClearCSDSW5_Data macro
macro ClearCSDSW5_Data
	and		[Port_0_Data_SHADE], ~20h
	mov		a, [Port_0_Data_SHADE]
	mov		reg[CSDSW5_Data_ADDR], a
endm

; CSDSW15 address and mask equates
CSDSW15_Data_ADDR:	equ	0h
CSDSW15_DriveMode_0_ADDR:	equ	100h
CSDSW15_DriveMode_1_ADDR:	equ	101h
CSDSW15_IntEn_ADDR:	equ	1h
CSDSW15_MASK:	equ	40h
CSDSW15_MUXBusCtrl_ADDR:	equ	1d8h
; CSDSW15_Data access macros
;   GetCSDSW15_Data macro, return in a
macro GetCSDSW15_Data
	mov		a,[Port_0_Data_SHADE]
	and		a, 40h
endm
;   SetCSDSW15_Data macro
macro SetCSDSW15_Data
	or		[Port_0_Data_SHADE], 40h
	mov		a, [Port_0_Data_SHADE]
	mov		reg[CSDSW15_Data_ADDR], a
endm
;   ClearCSDSW15_Data macro
macro ClearCSDSW15_Data
	and		[Port_0_Data_SHADE], ~40h
	mov		a, [Port_0_Data_SHADE]
	mov		reg[CSDSW15_Data_ADDR], a
endm

; CSDSW6 address and mask equates
CSDSW6_Data_ADDR:	equ	0h
CSDSW6_DriveMode_0_ADDR:	equ	100h
CSDSW6_DriveMode_1_ADDR:	equ	101h
CSDSW6_IntEn_ADDR:	equ	1h
CSDSW6_MASK:	equ	80h
CSDSW6_MUXBusCtrl_ADDR:	equ	1d8h
; CSDSW6_Data access macros
;   GetCSDSW6_Data macro, return in a
macro GetCSDSW6_Data
	mov		a,[Port_0_Data_SHADE]
	and		a, 80h
endm
;   SetCSDSW6_Data macro
macro SetCSDSW6_Data
	or		[Port_0_Data_SHADE], 80h
	mov		a, [Port_0_Data_SHADE]
	mov		reg[CSDSW6_Data_ADDR], a
endm
;   ClearCSDSW6_Data macro
macro ClearCSDSW6_Data
	and		[Port_0_Data_SHADE], ~80h
	mov		a, [Port_0_Data_SHADE]
	mov		reg[CSDSW6_Data_ADDR], a
endm

; EzI2CsSDA address and mask equates
EzI2CsSDA_Data_ADDR:	equ	4h
EzI2CsSDA_DriveMode_0_ADDR:	equ	104h
EzI2CsSDA_DriveMode_1_ADDR:	equ	105h
EzI2CsSDA_IntEn_ADDR:	equ	5h
EzI2CsSDA_MASK:	equ	1h
EzI2CsSDA_MUXBusCtrl_ADDR:	equ	1d9h
; EzI2CsSDA_Data access macros
;   GetEzI2CsSDA_Data macro, return in a
macro GetEzI2CsSDA_Data
	mov		a,[Port_1_Data_SHADE]
	and		a, 1h
endm
;   SetEzI2CsSDA_Data macro
macro SetEzI2CsSDA_Data
	or		[Port_1_Data_SHADE], 1h
	mov		a, [Port_1_Data_SHADE]
	mov		reg[EzI2CsSDA_Data_ADDR], a
endm
;   ClearEzI2CsSDA_Data macro
macro ClearEzI2CsSDA_Data
	and		[Port_1_Data_SHADE], ~1h
	mov		a, [Port_1_Data_SHADE]
	mov		reg[EzI2CsSDA_Data_ADDR], a
endm

; EzI2CsSCL address and mask equates
EzI2CsSCL_Data_ADDR:	equ	4h
EzI2CsSCL_DriveMode_0_ADDR:	equ	104h
EzI2CsSCL_DriveMode_1_ADDR:	equ	105h
EzI2CsSCL_IntEn_ADDR:	equ	5h
EzI2CsSCL_MASK:	equ	2h
EzI2CsSCL_MUXBusCtrl_ADDR:	equ	1d9h
; EzI2CsSCL_Data access macros
;   GetEzI2CsSCL_Data macro, return in a
macro GetEzI2CsSCL_Data
	mov		a,[Port_1_Data_SHADE]
	and		a, 2h
endm
;   SetEzI2CsSCL_Data macro
macro SetEzI2CsSCL_Data
	or		[Port_1_Data_SHADE], 2h
	mov		a, [Port_1_Data_SHADE]
	mov		reg[EzI2CsSCL_Data_ADDR], a
endm
;   ClearEzI2CsSCL_Data macro
macro ClearEzI2CsSCL_Data
	and		[Port_1_Data_SHADE], ~2h
	mov		a, [Port_1_Data_SHADE]
	mov		reg[EzI2CsSCL_Data_ADDR], a
endm

; CSDSW29 address and mask equates
CSDSW29_Data_ADDR:	equ	4h
CSDSW29_DriveMode_0_ADDR:	equ	104h
CSDSW29_DriveMode_1_ADDR:	equ	105h
CSDSW29_IntEn_ADDR:	equ	5h
CSDSW29_MASK:	equ	8h
CSDSW29_MUXBusCtrl_ADDR:	equ	1d9h
; CSDSW29_Data access macros
;   GetCSDSW29_Data macro, return in a
macro GetCSDSW29_Data
	mov		a,[Port_1_Data_SHADE]
	and		a, 8h
endm
;   SetCSDSW29_Data macro
macro SetCSDSW29_Data
	or		[Port_1_Data_SHADE], 8h
	mov		a, [Port_1_Data_SHADE]
	mov		reg[CSDSW29_Data_ADDR], a
endm
;   ClearCSDSW29_Data macro
macro ClearCSDSW29_Data
	and		[Port_1_Data_SHADE], ~8h
	mov		a, [Port_1_Data_SHADE]
	mov		reg[CSDSW29_Data_ADDR], a
endm

; CSDSW7 address and mask equates
CSDSW7_Data_ADDR:	equ	4h
CSDSW7_DriveMode_0_ADDR:	equ	104h
CSDSW7_DriveMode_1_ADDR:	equ	105h
CSDSW7_IntEn_ADDR:	equ	5h
CSDSW7_MASK:	equ	20h
CSDSW7_MUXBusCtrl_ADDR:	equ	1d9h
; CSDSW7_Data access macros
;   GetCSDSW7_Data macro, return in a
macro GetCSDSW7_Data
	mov		a,[Port_1_Data_SHADE]
	and		a, 20h
endm
;   SetCSDSW7_Data macro
macro SetCSDSW7_Data
	or		[Port_1_Data_SHADE], 20h
	mov		a, [Port_1_Data_SHADE]
	mov		reg[CSDSW7_Data_ADDR], a
endm
;   ClearCSDSW7_Data macro
macro ClearCSDSW7_Data
	and		[Port_1_Data_SHADE], ~20h
	mov		a, [Port_1_Data_SHADE]
	mov		reg[CSDSW7_Data_ADDR], a
endm

; CSDSW28 address and mask equates
CSDSW28_Data_ADDR:	equ	4h
CSDSW28_DriveMode_0_ADDR:	equ	104h
CSDSW28_DriveMode_1_ADDR:	equ	105h
CSDSW28_IntEn_ADDR:	equ	5h
CSDSW28_MASK:	equ	80h
CSDSW28_MUXBusCtrl_ADDR:	equ	1d9h
; CSDSW28_Data access macros
;   GetCSDSW28_Data macro, return in a
macro GetCSDSW28_Data
	mov		a,[Port_1_Data_SHADE]
	and		a, 80h
endm
;   SetCSDSW28_Data macro
macro SetCSDSW28_Data
	or		[Port_1_Data_SHADE], 80h
	mov		a, [Port_1_Data_SHADE]
	mov		reg[CSDSW28_Data_ADDR], a
endm
;   ClearCSDSW28_Data macro
macro ClearCSDSW28_Data
	and		[Port_1_Data_SHADE], ~80h
	mov		a, [Port_1_Data_SHADE]
	mov		reg[CSDSW28_Data_ADDR], a
endm

; CSDSW8 address and mask equates
CSDSW8_Data_ADDR:	equ	8h
CSDSW8_DriveMode_0_ADDR:	equ	108h
CSDSW8_DriveMode_1_ADDR:	equ	109h
CSDSW8_IntEn_ADDR:	equ	9h
CSDSW8_MASK:	equ	1h
CSDSW8_MUXBusCtrl_ADDR:	equ	1dah
; CSDSW8_Data access macros
;   GetCSDSW8_Data macro, return in a
macro GetCSDSW8_Data
	mov		a,[Port_2_Data_SHADE]
	and		a, 1h
endm
;   SetCSDSW8_Data macro
macro SetCSDSW8_Data
	or		[Port_2_Data_SHADE], 1h
	mov		a, [Port_2_Data_SHADE]
	mov		reg[CSDSW8_Data_ADDR], a
endm
;   ClearCSDSW8_Data macro
macro ClearCSDSW8_Data
	and		[Port_2_Data_SHADE], ~1h
	mov		a, [Port_2_Data_SHADE]
	mov		reg[CSDSW8_Data_ADDR], a
endm

; CSDSW1 address and mask equates
CSDSW1_Data_ADDR:	equ	8h
CSDSW1_DriveMode_0_ADDR:	equ	108h
CSDSW1_DriveMode_1_ADDR:	equ	109h
CSDSW1_IntEn_ADDR:	equ	9h
CSDSW1_MASK:	equ	2h
CSDSW1_MUXBusCtrl_ADDR:	equ	1dah
; CSDSW1_Data access macros
;   GetCSDSW1_Data macro, return in a
macro GetCSDSW1_Data
	mov		a,[Port_2_Data_SHADE]
	and		a, 2h
endm
;   SetCSDSW1_Data macro
macro SetCSDSW1_Data
	or		[Port_2_Data_SHADE], 2h
	mov		a, [Port_2_Data_SHADE]
	mov		reg[CSDSW1_Data_ADDR], a
endm
;   ClearCSDSW1_Data macro
macro ClearCSDSW1_Data
	and		[Port_2_Data_SHADE], ~2h
	mov		a, [Port_2_Data_SHADE]
	mov		reg[CSDSW1_Data_ADDR], a
endm

; CSDSW21 address and mask equates
CSDSW21_Data_ADDR:	equ	8h
CSDSW21_DriveMode_0_ADDR:	equ	108h
CSDSW21_DriveMode_1_ADDR:	equ	109h
CSDSW21_IntEn_ADDR:	equ	9h
CSDSW21_MASK:	equ	4h
CSDSW21_MUXBusCtrl_ADDR:	equ	1dah
; CSDSW21_Data access macros
;   GetCSDSW21_Data macro, return in a
macro GetCSDSW21_Data
	mov		a,[Port_2_Data_SHADE]
	and		a, 4h
endm
;   SetCSDSW21_Data macro
macro SetCSDSW21_Data
	or		[Port_2_Data_SHADE], 4h
	mov		a, [Port_2_Data_SHADE]
	mov		reg[CSDSW21_Data_ADDR], a
endm
;   ClearCSDSW21_Data macro
macro ClearCSDSW21_Data
	and		[Port_2_Data_SHADE], ~4h
	mov		a, [Port_2_Data_SHADE]
	mov		reg[CSDSW21_Data_ADDR], a
endm

; CSDSW2 address and mask equates
CSDSW2_Data_ADDR:	equ	8h
CSDSW2_DriveMode_0_ADDR:	equ	108h
CSDSW2_DriveMode_1_ADDR:	equ	109h
CSDSW2_IntEn_ADDR:	equ	9h
CSDSW2_MASK:	equ	8h
CSDSW2_MUXBusCtrl_ADDR:	equ	1dah
; CSDSW2_Data access macros
;   GetCSDSW2_Data macro, return in a
macro GetCSDSW2_Data
	mov		a,[Port_2_Data_SHADE]
	and		a, 8h
endm
;   SetCSDSW2_Data macro
macro SetCSDSW2_Data
	or		[Port_2_Data_SHADE], 8h
	mov		a, [Port_2_Data_SHADE]
	mov		reg[CSDSW2_Data_ADDR], a
endm
;   ClearCSDSW2_Data macro
macro ClearCSDSW2_Data
	and		[Port_2_Data_SHADE], ~8h
	mov		a, [Port_2_Data_SHADE]
	mov		reg[CSDSW2_Data_ADDR], a
endm

; CSDSW20 address and mask equates
CSDSW20_Data_ADDR:	equ	8h
CSDSW20_DriveMode_0_ADDR:	equ	108h
CSDSW20_DriveMode_1_ADDR:	equ	109h
CSDSW20_IntEn_ADDR:	equ	9h
CSDSW20_MASK:	equ	10h
CSDSW20_MUXBusCtrl_ADDR:	equ	1dah
; CSDSW20_Data access macros
;   GetCSDSW20_Data macro, return in a
macro GetCSDSW20_Data
	mov		a,[Port_2_Data_SHADE]
	and		a, 10h
endm
;   SetCSDSW20_Data macro
macro SetCSDSW20_Data
	or		[Port_2_Data_SHADE], 10h
	mov		a, [Port_2_Data_SHADE]
	mov		reg[CSDSW20_Data_ADDR], a
endm
;   ClearCSDSW20_Data macro
macro ClearCSDSW20_Data
	and		[Port_2_Data_SHADE], ~10h
	mov		a, [Port_2_Data_SHADE]
	mov		reg[CSDSW20_Data_ADDR], a
endm

; CSDSW3 address and mask equates
CSDSW3_Data_ADDR:	equ	8h
CSDSW3_DriveMode_0_ADDR:	equ	108h
CSDSW3_DriveMode_1_ADDR:	equ	109h
CSDSW3_IntEn_ADDR:	equ	9h
CSDSW3_MASK:	equ	20h
CSDSW3_MUXBusCtrl_ADDR:	equ	1dah
; CSDSW3_Data access macros
;   GetCSDSW3_Data macro, return in a
macro GetCSDSW3_Data
	mov		a,[Port_2_Data_SHADE]
	and		a, 20h
endm
;   SetCSDSW3_Data macro
macro SetCSDSW3_Data
	or		[Port_2_Data_SHADE], 20h
	mov		a, [Port_2_Data_SHADE]
	mov		reg[CSDSW3_Data_ADDR], a
endm
;   ClearCSDSW3_Data macro
macro ClearCSDSW3_Data
	and		[Port_2_Data_SHADE], ~20h
	mov		a, [Port_2_Data_SHADE]
	mov		reg[CSDSW3_Data_ADDR], a
endm

; CSDSW19 address and mask equates
CSDSW19_Data_ADDR:	equ	8h
CSDSW19_DriveMode_0_ADDR:	equ	108h
CSDSW19_DriveMode_1_ADDR:	equ	109h
CSDSW19_IntEn_ADDR:	equ	9h
CSDSW19_MASK:	equ	40h
CSDSW19_MUXBusCtrl_ADDR:	equ	1dah
; CSDSW19_Data access macros
;   GetCSDSW19_Data macro, return in a
macro GetCSDSW19_Data
	mov		a,[Port_2_Data_SHADE]
	and		a, 40h
endm
;   SetCSDSW19_Data macro
macro SetCSDSW19_Data
	or		[Port_2_Data_SHADE], 40h
	mov		a, [Port_2_Data_SHADE]
	mov		reg[CSDSW19_Data_ADDR], a
endm
;   ClearCSDSW19_Data macro
macro ClearCSDSW19_Data
	and		[Port_2_Data_SHADE], ~40h
	mov		a, [Port_2_Data_SHADE]
	mov		reg[CSDSW19_Data_ADDR], a
endm

; CSDSW22 address and mask equates
CSDSW22_Data_ADDR:	equ	8h
CSDSW22_DriveMode_0_ADDR:	equ	108h
CSDSW22_DriveMode_1_ADDR:	equ	109h
CSDSW22_IntEn_ADDR:	equ	9h
CSDSW22_MASK:	equ	80h
CSDSW22_MUXBusCtrl_ADDR:	equ	1dah
; CSDSW22_Data access macros
;   GetCSDSW22_Data macro, return in a
macro GetCSDSW22_Data
	mov		a,[Port_2_Data_SHADE]
	and		a, 80h
endm
;   SetCSDSW22_Data macro
macro SetCSDSW22_Data
	or		[Port_2_Data_SHADE], 80h
	mov		a, [Port_2_Data_SHADE]
	mov		reg[CSDSW22_Data_ADDR], a
endm
;   ClearCSDSW22_Data macro
macro ClearCSDSW22_Data
	and		[Port_2_Data_SHADE], ~80h
	mov		a, [Port_2_Data_SHADE]
	mov		reg[CSDSW22_Data_ADDR], a
endm

; CSDSW14 address and mask equates
CSDSW14_Data_ADDR:	equ	ch
CSDSW14_DriveMode_0_ADDR:	equ	10ch
CSDSW14_DriveMode_1_ADDR:	equ	10dh
CSDSW14_IntEn_ADDR:	equ	dh
CSDSW14_MASK:	equ	1h
CSDSW14_MUXBusCtrl_ADDR:	equ	1dbh
; CSDSW14_Data access macros
;   GetCSDSW14_Data macro, return in a
macro GetCSDSW14_Data
	mov		a,[Port_3_Data_SHADE]
	and		a, 1h
endm
;   SetCSDSW14_Data macro
macro SetCSDSW14_Data
	or		[Port_3_Data_SHADE], 1h
	mov		a, [Port_3_Data_SHADE]
	mov		reg[CSDSW14_Data_ADDR], a
endm
;   ClearCSDSW14_Data macro
macro ClearCSDSW14_Data
	and		[Port_3_Data_SHADE], ~1h
	mov		a, [Port_3_Data_SHADE]
	mov		reg[CSDSW14_Data_ADDR], a
endm

; CSDSW27 address and mask equates
CSDSW27_Data_ADDR:	equ	ch
CSDSW27_DriveMode_0_ADDR:	equ	10ch
CSDSW27_DriveMode_1_ADDR:	equ	10dh
CSDSW27_IntEn_ADDR:	equ	dh
CSDSW27_MASK:	equ	2h
CSDSW27_MUXBusCtrl_ADDR:	equ	1dbh
; CSDSW27_Data access macros
;   GetCSDSW27_Data macro, return in a
macro GetCSDSW27_Data
	mov		a,[Port_3_Data_SHADE]
	and		a, 2h
endm
;   SetCSDSW27_Data macro
macro SetCSDSW27_Data
	or		[Port_3_Data_SHADE], 2h
	mov		a, [Port_3_Data_SHADE]
	mov		reg[CSDSW27_Data_ADDR], a
endm
;   ClearCSDSW27_Data macro
macro ClearCSDSW27_Data
	and		[Port_3_Data_SHADE], ~2h
	mov		a, [Port_3_Data_SHADE]
	mov		reg[CSDSW27_Data_ADDR], a
endm

; CSDSW13 address and mask equates
CSDSW13_Data_ADDR:	equ	ch
CSDSW13_DriveMode_0_ADDR:	equ	10ch
CSDSW13_DriveMode_1_ADDR:	equ	10dh
CSDSW13_IntEn_ADDR:	equ	dh
CSDSW13_MASK:	equ	4h
CSDSW13_MUXBusCtrl_ADDR:	equ	1dbh
; CSDSW13_Data access macros
;   GetCSDSW13_Data macro, return in a
macro GetCSDSW13_Data
	mov		a,[Port_3_Data_SHADE]
	and		a, 4h
endm
;   SetCSDSW13_Data macro
macro SetCSDSW13_Data
	or		[Port_3_Data_SHADE], 4h
	mov		a, [Port_3_Data_SHADE]
	mov		reg[CSDSW13_Data_ADDR], a
endm
;   ClearCSDSW13_Data macro
macro ClearCSDSW13_Data
	and		[Port_3_Data_SHADE], ~4h
	mov		a, [Port_3_Data_SHADE]
	mov		reg[CSDSW13_Data_ADDR], a
endm

; CSDSW26 address and mask equates
CSDSW26_Data_ADDR:	equ	ch
CSDSW26_DriveMode_0_ADDR:	equ	10ch
CSDSW26_DriveMode_1_ADDR:	equ	10dh
CSDSW26_IntEn_ADDR:	equ	dh
CSDSW26_MASK:	equ	8h
CSDSW26_MUXBusCtrl_ADDR:	equ	1dbh
; CSDSW26_Data access macros
;   GetCSDSW26_Data macro, return in a
macro GetCSDSW26_Data
	mov		a,[Port_3_Data_SHADE]
	and		a, 8h
endm
;   SetCSDSW26_Data macro
macro SetCSDSW26_Data
	or		[Port_3_Data_SHADE], 8h
	mov		a, [Port_3_Data_SHADE]
	mov		reg[CSDSW26_Data_ADDR], a
endm
;   ClearCSDSW26_Data macro
macro ClearCSDSW26_Data
	and		[Port_3_Data_SHADE], ~8h
	mov		a, [Port_3_Data_SHADE]
	mov		reg[CSDSW26_Data_ADDR], a
endm

; CSDSW12 address and mask equates
CSDSW12_Data_ADDR:	equ	ch
CSDSW12_DriveMode_0_ADDR:	equ	10ch
CSDSW12_DriveMode_1_ADDR:	equ	10dh
CSDSW12_IntEn_ADDR:	equ	dh
CSDSW12_MASK:	equ	10h
CSDSW12_MUXBusCtrl_ADDR:	equ	1dbh
; CSDSW12_Data access macros
;   GetCSDSW12_Data macro, return in a
macro GetCSDSW12_Data
	mov		a,[Port_3_Data_SHADE]
	and		a, 10h
endm
;   SetCSDSW12_Data macro
macro SetCSDSW12_Data
	or		[Port_3_Data_SHADE], 10h
	mov		a, [Port_3_Data_SHADE]
	mov		reg[CSDSW12_Data_ADDR], a
endm
;   ClearCSDSW12_Data macro
macro ClearCSDSW12_Data
	and		[Port_3_Data_SHADE], ~10h
	mov		a, [Port_3_Data_SHADE]
	mov		reg[CSDSW12_Data_ADDR], a
endm

; CSDSW25 address and mask equates
CSDSW25_Data_ADDR:	equ	ch
CSDSW25_DriveMode_0_ADDR:	equ	10ch
CSDSW25_DriveMode_1_ADDR:	equ	10dh
CSDSW25_IntEn_ADDR:	equ	dh
CSDSW25_MASK:	equ	20h
CSDSW25_MUXBusCtrl_ADDR:	equ	1dbh
; CSDSW25_Data access macros
;   GetCSDSW25_Data macro, return in a
macro GetCSDSW25_Data
	mov		a,[Port_3_Data_SHADE]
	and		a, 20h
endm
;   SetCSDSW25_Data macro
macro SetCSDSW25_Data
	or		[Port_3_Data_SHADE], 20h
	mov		a, [Port_3_Data_SHADE]
	mov		reg[CSDSW25_Data_ADDR], a
endm
;   ClearCSDSW25_Data macro
macro ClearCSDSW25_Data
	and		[Port_3_Data_SHADE], ~20h
	mov		a, [Port_3_Data_SHADE]
	mov		reg[CSDSW25_Data_ADDR], a
endm

; CSDSW11 address and mask equates
CSDSW11_Data_ADDR:	equ	ch
CSDSW11_DriveMode_0_ADDR:	equ	10ch
CSDSW11_DriveMode_1_ADDR:	equ	10dh
CSDSW11_IntEn_ADDR:	equ	dh
CSDSW11_MASK:	equ	40h
CSDSW11_MUXBusCtrl_ADDR:	equ	1dbh
; CSDSW11_Data access macros
;   GetCSDSW11_Data macro, return in a
macro GetCSDSW11_Data
	mov		a,[Port_3_Data_SHADE]
	and		a, 40h
endm
;   SetCSDSW11_Data macro
macro SetCSDSW11_Data
	or		[Port_3_Data_SHADE], 40h
	mov		a, [Port_3_Data_SHADE]
	mov		reg[CSDSW11_Data_ADDR], a
endm
;   ClearCSDSW11_Data macro
macro ClearCSDSW11_Data
	and		[Port_3_Data_SHADE], ~40h
	mov		a, [Port_3_Data_SHADE]
	mov		reg[CSDSW11_Data_ADDR], a
endm

; CSDSW24 address and mask equates
CSDSW24_Data_ADDR:	equ	ch
CSDSW24_DriveMode_0_ADDR:	equ	10ch
CSDSW24_DriveMode_1_ADDR:	equ	10dh
CSDSW24_IntEn_ADDR:	equ	dh
CSDSW24_MASK:	equ	80h
CSDSW24_MUXBusCtrl_ADDR:	equ	1dbh
; CSDSW24_Data access macros
;   GetCSDSW24_Data macro, return in a
macro GetCSDSW24_Data
	mov		a,[Port_3_Data_SHADE]
	and		a, 80h
endm
;   SetCSDSW24_Data macro
macro SetCSDSW24_Data
	or		[Port_3_Data_SHADE], 80h
	mov		a, [Port_3_Data_SHADE]
	mov		reg[CSDSW24_Data_ADDR], a
endm
;   ClearCSDSW24_Data macro
macro ClearCSDSW24_Data
	and		[Port_3_Data_SHADE], ~80h
	mov		a, [Port_3_Data_SHADE]
	mov		reg[CSDSW24_Data_ADDR], a
endm

; CSDSW10 address and mask equates
CSDSW10_Data_ADDR:	equ	10h
CSDSW10_DriveMode_0_ADDR:	equ	110h
CSDSW10_DriveMode_1_ADDR:	equ	111h
CSDSW10_IntEn_ADDR:	equ	11h
CSDSW10_MASK:	equ	1h
CSDSW10_MUXBusCtrl_ADDR:	equ	1dfh
; CSDSW10_Data access macros
;   GetCSDSW10_Data macro, return in a
macro GetCSDSW10_Data
	mov		a,[Port_4_Data_SHADE]
	and		a, 1h
endm
;   SetCSDSW10_Data macro
macro SetCSDSW10_Data
	or		[Port_4_Data_SHADE], 1h
	mov		a, [Port_4_Data_SHADE]
	mov		reg[CSDSW10_Data_ADDR], a
endm
;   ClearCSDSW10_Data macro
macro ClearCSDSW10_Data
	and		[Port_4_Data_SHADE], ~1h
	mov		a, [Port_4_Data_SHADE]
	mov		reg[CSDSW10_Data_ADDR], a
endm

; CSDSW23 address and mask equates
CSDSW23_Data_ADDR:	equ	10h
CSDSW23_DriveMode_0_ADDR:	equ	110h
CSDSW23_DriveMode_1_ADDR:	equ	111h
CSDSW23_IntEn_ADDR:	equ	11h
CSDSW23_MASK:	equ	2h
CSDSW23_MUXBusCtrl_ADDR:	equ	1dfh
; CSDSW23_Data access macros
;   GetCSDSW23_Data macro, return in a
macro GetCSDSW23_Data
	mov		a,[Port_4_Data_SHADE]
	and		a, 2h
endm
;   SetCSDSW23_Data macro
macro SetCSDSW23_Data
	or		[Port_4_Data_SHADE], 2h
	mov		a, [Port_4_Data_SHADE]
	mov		reg[CSDSW23_Data_ADDR], a
endm
;   ClearCSDSW23_Data macro
macro ClearCSDSW23_Data
	and		[Port_4_Data_SHADE], ~2h
	mov		a, [Port_4_Data_SHADE]
	mov		reg[CSDSW23_Data_ADDR], a
endm

; CSDSW9 address and mask equates
CSDSW9_Data_ADDR:	equ	10h
CSDSW9_DriveMode_0_ADDR:	equ	110h
CSDSW9_DriveMode_1_ADDR:	equ	111h
CSDSW9_IntEn_ADDR:	equ	11h
CSDSW9_MASK:	equ	4h
CSDSW9_MUXBusCtrl_ADDR:	equ	1dfh
; CSDSW9_Data access macros
;   GetCSDSW9_Data macro, return in a
macro GetCSDSW9_Data
	mov		a,[Port_4_Data_SHADE]
	and		a, 4h
endm
;   SetCSDSW9_Data macro
macro SetCSDSW9_Data
	or		[Port_4_Data_SHADE], 4h
	mov		a, [Port_4_Data_SHADE]
	mov		reg[CSDSW9_Data_ADDR], a
endm
;   ClearCSDSW9_Data macro
macro ClearCSDSW9_Data
	and		[Port_4_Data_SHADE], ~4h
	mov		a, [Port_4_Data_SHADE]
	mov		reg[CSDSW9_Data_ADDR], a
endm

; CSDSW0 address and mask equates
CSDSW0_Data_ADDR:	equ	10h
CSDSW0_DriveMode_0_ADDR:	equ	110h
CSDSW0_DriveMode_1_ADDR:	equ	111h
CSDSW0_IntEn_ADDR:	equ	11h
CSDSW0_MASK:	equ	8h
CSDSW0_MUXBusCtrl_ADDR:	equ	1dfh
; CSDSW0_Data access macros
;   GetCSDSW0_Data macro, return in a
macro GetCSDSW0_Data
	mov		a,[Port_4_Data_SHADE]
	and		a, 8h
endm
;   SetCSDSW0_Data macro
macro SetCSDSW0_Data
	or		[Port_4_Data_SHADE], 8h
	mov		a, [Port_4_Data_SHADE]
	mov		reg[CSDSW0_Data_ADDR], a
endm
;   ClearCSDSW0_Data macro
macro ClearCSDSW0_Data
	and		[Port_4_Data_SHADE], ~8h
	mov		a, [Port_4_Data_SHADE]
	mov		reg[CSDSW0_Data_ADDR], a
endm

