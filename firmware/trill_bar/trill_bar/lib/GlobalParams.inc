;  Generated by PSoC Designer 5.3.2710
;
;=============================================================================
;  FILENAME:   GlobalParams.inc
;  DATE:       31 January 2006
;
;  DESCRIPTION:
;  Constants describing many of the global parameter settings.
;  This file contains equates to support oscillator register initialization
;  for the CY8C20636AN
;
;  Copyright (c) Cypress Semiconductor 2012. All Rights Reserved.
;
; NOTES:
; Do not modify this file. It is generated by PSoC Designer each time the
; generate application function is run. The values of the parameters in this
; file can be modified by changing the values of the global parameters in the
; device editor.
;=============================================================================
;

IMO_SETTING:			equ	2h

CPU_CLOCK:				equ	3h	;CPU clock value
CPU_CLOCK_MASK:			equ	7h	;CPU clock mask
CPU_CLOCK_JUST:			equ	3h	;CPU clock value justified

SLEEP_TIMER:			equ	0h	;Sleep Timer value
SLEEP_TIMER_MASK:		equ	18h	;Sleep Timer mask
SLEEP_TIMER_JUST:		equ	0h	;Sleep Timer value justified

SYSCLK_SOURCE:			equ	(0h | 0h)	;SysClk Source setting
SYSCLK_SOURCE_MASK:		equ	(4h | 2h)	;SysClk Source setting mask
SYSCLK_SOURCE_JUST:		equ	(0h | 0h)	;SysClk Source setting justified

TRIP_VOLTAGE:           equ 7h  ;Trip Voltage value
TRIP_VOLTAGE_MASK:      equ 7h  ;Trip Voltage mask
TRIP_VOLTAGE_JUST:      equ 7h  ;Trip Voltage justified
                              
LVD_TBEN:               equ 0   ;Low Voltage Throttle-back enable value
LVD_TBEN_MASK:          equ 8   ;Low Voltage Throttle-back enable mask
LVD_TBEN_JUST:          equ 0   ;Low Voltage Throttle-back enable justified

WATCHDOG_ENABLE:		equ 0	;Watchdog Enable 1 = Enable
INTERRUPT_MODE:         equ 0   ;Interrupt Mode, 0 = Low, 1 = ChangeFromRead

P1_0_DATA_OUTPUT:		equ	(0h | 0h)	;P1[0] Data Output setting
P1_0_DATA_OUTPUT_MASK:	equ	(2h | 1h)	;P1[0] Data Output setting mask
P1_0_DATA_OUTPUT_JUST:	equ	(0h | 0h)	;P1[0] Data Output justified

P1_2_DATA_OUTPUT:		equ	(0h | 0h)	;P1[2] Data Output setting
P1_2_DATA_OUTPUT_MASK:	equ	(8h | 4h)	;P1[2] Data Output setting mask
P1_2_DATA_OUTPUT_JUST:	equ	(0h | 0h)	;P1[2] Data Output justified

P1_4_DATA_OUTPUT:		equ	(0h | 0h)	;P1[4] Data Output setting
P1_4_DATA_OUTPUT_MASK:	equ	(20h | 10h)	;P1[4] Data Output setting mask
P1_4_DATA_OUTPUT_JUST:	equ	(0h | 0h)	;P1[4] Data Output justified

P1_6_DATA_OUTPUT:		equ	(0h | 0h)	;P1[6] Data Output setting
P1_6_DATA_OUTPUT_MASK:	equ	(80h | 40h)	;P1[6] Data Output setting mask
P1_6_DATA_OUTPUT_JUST:	equ	(0h | 0h)	;P1[6] Data Output justified

IMO_SET_6MHZ:			equ 01h	 ; IMO setting for 6MHz
IMO_SET_12MHZ:			equ 00h	 ; IMO setting for 12MHz
IMO_SET_24MHZ:			equ 02h	 ; IMO setting for 24MHz

POR_LEVEL:				equ (0h | 0h)            ; POR setting
POR_LEVEL_MASK:			equ (80h | 30h)      ; POR setting mask
POR_LEVEL_JUST:			equ (0h | 0h)        ; POR setting justified

USB_USED:				equ 0h	 ;USB deployed (0 - Not used, 1 - USB used)

ILO_SETTING:                   equ 0h  ; ILO frequecy
ILO_SETTING_MASK:              equ 20h ; ILO frequecy mask
ILO_SETTING_JUST:              equ 0h  ; ILO frequecy justified

SELECT_32K:                    equ 0h  ; 32K select value
SELECT_32K_MASK:               equ 80h ; 32K select mask
SELECT_32K_JUST:               equ 0h  ; 32K select value justified
;
; register initial values
;
PORT_0_DRIVE_0:			equ 0h	;Port 0 drive mode 0 register (PRT0DM0)
PORT_0_DRIVE_1:			equ ffh	;Port 0 drive mode 1 register (PRT0DM1)
PORT_0_INTENABLE:		equ 0h	;Port 0 interrupt enable register (PRT0IE)

PORT_1_DRIVE_0:			equ 3h	;Port 1 drive mode 0 register (PRT1DM0)
PORT_1_DRIVE_1:			equ abh	;Port 1 drive mode 1 register (PRT1DM1)
PORT_1_INTENABLE:		equ 0h	;Port 1 interrupt enable register (PRT1IE)

PORT_2_DRIVE_0:			equ 0h	;Port 2 drive mode 0 register (PRT2DM0)
PORT_2_DRIVE_1:			equ ffh	;Port 2 drive mode 1 register (PRT2DM1)
PORT_2_INTENABLE:		equ 0h	;Port 2 interrupt enable register (PRT2IE)

PORT_3_DRIVE_0:			equ 0h	;Port 3 drive mode 0 register (PRT3DM0)
PORT_3_DRIVE_1:			equ ffh	;Port 3 drive mode 1 register (PRT3DM1)
PORT_3_INTENABLE:		equ 0h	;Port 3 interrupt enable register (PRT3IE)

PORT_4_DRIVE_0:			equ 0h	;Port 4 drive mode 0 register (PRT4DM0)
PORT_4_DRIVE_1:			equ fh	;Port 4 drive mode 1 register (PRT4DM1)
PORT_4_INTENABLE:		equ 0h	;Port 4 interrupt enable register (PRT4IE)

; end of file GlobalParams.inc
